#include <zmk-unicode/keys-extra.h>

#undef ZMK_LEADER_SEQUENCE
#define ZMK_LEADER_SEQUENCE(name, leader_bindings, leader_sequence) \
    / { \
        behaviors { \
            leader: leader { \
                compatible = "zmk,behavior-leader-key"; \
                #binding-cells = <0>; \
                ignore-keys = <LSHFT RSHFT>; \
                leader_sequence_ ## name { \
                    bindings = <leader_bindings>; \
                    sequence = <leader_sequence>; \
                }; \
            }; \
        }; \
    };

/* German umlauts */
ZMK_LEADER_SEQUENCE(de_ae,      &uc UC_DE_AE,         A E)  // ä
ZMK_LEADER_SEQUENCE(de_oe,      &uc UC_DE_OE,         O E)  // ö
ZMK_LEADER_SEQUENCE(de_ue,      &uc UC_DE_UE,         U E)  // ü
ZMK_LEADER_SEQUENCE(de_eszett,  &uc UC_DE_SS,         S S)  // ß

/* Spanish vowels with acute accent */
ZMK_LEADER_SEQUENCE(es_a,      &uc UC_ES_A_ACUTE,     A) // Á, á
ZMK_LEADER_SEQUENCE(es_e,      &uc UC_ES_E_ACUTE,     E) // É, é
ZMK_LEADER_SEQUENCE(es_i,      &uc UC_ES_I_ACUTE,     I) // Î, î
ZMK_LEADER_SEQUENCE(es_o,      &uc UC_ES_O_ACUTE,     O) // Ó, ó
ZMK_LEADER_SEQUENCE(es_u,      &uc UC_ES_U_ACUTE,     U) // Ú, ú

/* Special consonants and diaeresis */
ZMK_LEADER_SEQUENCE(es_n,      &uc UC_ES_N_TILDE,     N) // Ñ, ñ

/* Inverted punctuation marks */
ZMK_LEADER_SEQUENCE(es_ques,   &uc UC_INVERTED_QUESTION_MARK,  QMARK) // ¿
ZMK_LEADER_SEQUENCE(es_excl,   &uc UC_INVERTED_EXCLAMATION_MARK, EXCL) // ¡

/* C-Cedilla (ç / Ç) - Catalan, Portuguese, French */
ZMK_LEADER_SEQUENCE(cedilla_c,   &uc UC_FR_C_CEDILLA, C) // ç / Ç

/* Euro (€) */
ZMK_LEADER_SEQUENCE(sym_euro,    &uc UC_EURO_SIGN,  E E) // €

/* Degree symbol (°) */
ZMK_LEADER_SEQUENCE(sym_deg,     &uc UC_DEGREE_SIGN,  D) // °

/* Multiplication sign (×) */
ZMK_LEADER_SEQUENCE(sym_mult,    &uc UC_MULTIPLICATION_SIGN, X) // ×

// BLE and USB
#ifdef CONFIG_WIRELESS
ZMK_LEADER_SEQUENCE(usb,        &out OUT_USB,   U S B)
ZMK_LEADER_SEQUENCE(ble,        &out OUT_BLE,   B L E)
#endif // CONFIG_WIRELESS
ZMK_LEADER_SEQUENCE(reset,      &sys_reset,     R E S E T)
ZMK_LEADER_SEQUENCE(boot,       &bootloader,    B O O T)

