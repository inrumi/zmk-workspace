## config/boards/shields/crosses_v2_dongle/Kconfig.defconfig
```kconfig
if SHIELD_CROSSES_V2_DONGLE

config ZMK_SPLIT
    default y

config ZMK_SPLIT_BLE
    default y

config ZMK_SPLIT_ROLE_CENTRAL
    default y

config ZMK_KEYBOARD_NAME
    default "Crosses V2"

endif
```

## config/boards/shields/crosses_v2_dongle/Kconfig.shield
```kconfig
config SHIELD_CROSSES_V2_DONGLE
    def_bool $(shields_list_contains,crosses_v2_dongle)
```

## config/boards/shields/crosses_v2_peripheral_right/Kconfig.shield
```kconfig
config SHIELD_CROSSES_V2_PERIPHERAL_RIGHT
    def_bool $(shields_list_contains,crosses_v2_peripheral_right)
```
