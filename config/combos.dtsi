/*                KEY POSITIONS

  ╭─────────────────────╮ ╭─────────────────────╮
  │ LT4 LT3 LT2 LT1 LT0 │ │ RT0 RT1 RT2 RT3 RT4 │
  │ LM4 LM3 LM2 LM1 LM0 │ │ RM0 RM1 RM2 RM3 RM4 │
  │ LB4 LB3 LB2 LB1 LB0 │ │ RB0 RB1 RB2 RB3 RB4 │
  ╰───────╮ LH2 LH1 LH0 │ │ RH0 RH1 RH2 ╭───────╯
          ╰─────────────╯ ╰─────────────╯ */

#define COMBO_TERM_FAST 18
#define COMBO_TERM_SLOW 30

#define COMBO_IDLE_FAST 150
#define COMBO_IDLE_SLOW 50

/* Horizontal combos - left hand */

// I prefer ESC on my NAV layer
ZMK_COMBO(mouse, &smart_mouse, LT2 LT1,     DEF NAV NUM SYM, COMBO_TERM_FAST, COMBO_IDLE_FAST)
ZMK_COMBO(ldr,   &leader,      LT3 LT2,     DEF NAV NUM SYM, COMBO_TERM_FAST, COMBO_IDLE_FAST, LS(LCTRL),    KEYS_R)

#ifndef HAS_TRACKBALL
  #include "mouse.dtsi"
#endif

/* Horizontal combos - right hand */
ZMK_COMBO(bspc,  &kp BSPC,     RT1 RT2,     DEF NUM SYM,     COMBO_TERM_FAST, COMBO_IDLE_FAST)
ZMK_COMBO(del,   &kp DEL,      RT2 RT3,     DEF NUM SYM,     COMBO_TERM_FAST, COMBO_IDLE_FAST)

/* Vertical combos - left hand */
ZMK_COMBO(sys_r, &tog SYS,     LM2 LB2,     DEF,             COMBO_TERM_FAST, COMBO_IDLE_FAST)

/* Vertical combos - right hand */
ZMK_COMBO(sys_l, &tog SYS,     RM2 RB2,     DEF,             COMBO_TERM_FAST, COMBO_IDLE_FAST)